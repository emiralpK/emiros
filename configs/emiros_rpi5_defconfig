## configs/emiros_rpi5_defconfig
```kconfig
# EmiROS Buildroot Configuration for Raspberry Pi 5
# Architecture: aarch64 (ARM64)
# Features: X11 + XFCE4 Desktop + BusyBox httpd + Web Dashboard

# Target architecture
BR2_aarch64=y
BR2_GCC_TARGET_CPU="cortex-a76"

# Toolchain
BR2_TOOLCHAIN_EXTERNAL=y
BR2_TOOLCHAIN_EXTERNAL_BOOTLIN=y
BR2_TOOLCHAIN_EXTERNAL_BOOTLIN_AARCH64_GLIBC_STABLE=y

# System configuration
BR2_TARGET_GENERIC_HOSTNAME="emiros"
BR2_TARGET_GENERIC_ISSUE="Welcome to EmiROS v1.0"
BR2_TARGET_GENERIC_ROOT_PASSWD="emiros"
BR2_SYSTEM_DHCP="eth0"

# Init system - BusyBox init
BR2_INIT_BUSYBOX=y

# Rootfs overlay - relative path, NO BR2_EXTERNAL
BR2_ROOTFS_OVERLAY="rootfs_overlay"

# Kernel - use defconfig instead of custom config file
BR2_LINUX_KERNEL=y
BR2_LINUX_KERNEL_CUSTOM_TARBALL=y
BR2_LINUX_KERNEL_CUSTOM_TARBALL_LOCATION="https://github.com/raspberrypi/linux/archive/refs/tags/stable_20231123.tar.gz"
BR2_LINUX_KERNEL_DEFCONFIG="bcm2711"
BR2_LINUX_KERNEL_DTS_SUPPORT=y
BR2_LINUX_KERNEL_INTREE_DTS_NAME="broadcom/bcm2712-rpi-5-b"
BR2_LINUX_KERNEL_NEEDS_HOST_OPENSSL=y

# Raspberry Pi firmware
BR2_PACKAGE_RPI_FIRMWARE=y

# X11 Server (Xorg)
BR2_PACKAGE_XSERVER_XORG_SERVER=y
BR2_PACKAGE_XDRIVER_XF86_VIDEO_FBDEV=y
BR2_PACKAGE_XDRIVER_XF86_INPUT_EVDEV=y

# X11 libraries
BR2_PACKAGE_XLIB_LIBX11=y
BR2_PACKAGE_LIBERATION_FONTS=y

# XFCE4 Desktop Environment - individual packages
BR2_PACKAGE_LIBXFCE4UTIL=y
BR2_PACKAGE_LIBXFCE4UI=y
BR2_PACKAGE_XFCE4_PANEL=y
BR2_PACKAGE_XFCE4_SESSION=y
BR2_PACKAGE_XFCE4_SETTINGS=y
BR2_PACKAGE_XFCE4_TERMINAL=y
BR2_PACKAGE_XFCONF=y
BR2_PACKAGE_XFDESKTOP=y
BR2_PACKAGE_XFWM4=y
BR2_PACKAGE_THUNAR=y

# Desktop utilities
BR2_PACKAGE_DBUS=y

# Network
BR2_PACKAGE_DHCPCD=y
BR2_PACKAGE_DROPBEAR=y
BR2_PACKAGE_IPTABLES=y

# System utilities
BR2_PACKAGE_HTOP=y
BR2_PACKAGE_NANO=y

# Filesystem utilities
BR2_PACKAGE_E2FSPROGS=y
BR2_PACKAGE_DOSFSTOOLS=y

# Target filesystem
BR2_TARGET_ROOTFS_EXT2=y
BR2_TARGET_ROOTFS_EXT2_4=y
BR2_TARGET_ROOTFS_EXT2_SIZE="512M"

# Additional packages
BR2_PACKAGE_CA_CERTIFICATES=y
```
